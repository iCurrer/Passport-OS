## sdkconfig.defaults
```kconfig
# ---  ---
CONFIG_IDF_TARGET="esp32c3"
# :ESP32-C3  PSRAM, CONFIG_SPIRAM

# --- Flash ---
# FoloToy AI Passport  8MB Flash
CONFIG_ESPTOOLPY_FLASHSIZE_8MB=y
# 
CONFIG_ESPTOOLPY_HEADER_FLASHSIZE_UPDATE=y

# --- :USB-Serial-JTAG(C3  USB,GPIO18/19)---
#  UART0: TX=GPIO21 
CONFIG_ESP_CONSOLE_USB_SERIAL_JTAG=y
CONFIG_ESP_CONSOLE_SECONDARY_NONE=y

# --- LVGL ---
CONFIG_LV_COLOR_DEPTH_16=y
CONFIG_LV_FONT_MONTSERRAT_14=y
CONFIG_LV_FONT_MONTSERRAT_20=y
# LVGL  malloc (KB), RAM
# (25KB)+ ,24KB ; 48KB
CONFIG_LV_MEM_SIZE_KILOBYTES=48

# ---  ---
CONFIG_FREERTOS_HZ=1000

# --- BLE (badge gatt) ---
CONFIG_BT_ENABLED=y
CONFIG_BT_NIMBLE_ENABLED=y
CONFIG_BT_NIMBLE_ROLE_PERIPHERAL=y
CONFIG_BT_NIMBLE_ROLE_BROADCASTER=y
# BLE  -6dBm(,)
CONFIG_BT_CTRL_DFT_TX_POWER_LEVEL_N6=y

# --- : app  4MB, GB2312  ---
CONFIG_PARTITION_TABLE_CUSTOM=y
CONFIG_PARTITION_TABLE_CUSTOM_FILENAME="partitions.csv"

# --- LVGL (GB2312 6763 ) ---
CONFIG_LV_FONT_FMT_TXT_LARGE=y
# --- LVGL RLE (,) ---
CONFIG_LV_USE_FONT_COMPRESSED=y
```
